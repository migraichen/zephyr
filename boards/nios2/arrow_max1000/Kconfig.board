## boards/nios2/arrow_max1000/Kconfig.board
```kconfig
# SPDX-License-Identifier: Apache-2.0

config BOARD_ARROW_MAX1000
	bool "Arrow MAX1000 Board"
	depends on SOC_NIOS2E_ZEPHYR
```

## boards/nios2/arrow_max1000/Kconfig.defconfig
```kconfig
# SPDX-License-Identifier: Apache-2.0

if BOARD_ARROW_MAX1000

config BOARD
	default "arrow_max1000"

if FLASH

config SOC_FLASH_NIOS2_QSPI
	default y

if SOC_FLASH_NIOS2_QSPI

config SOC_FLASH_NIOS2_QSPI_DEV_NAME
	default "NIOS2_QSPI_FLASH"

if DISK_ACCESS_FLASH

config DISK_FLASH_DEV_NAME
	default SOC_FLASH_NIOS2_QSPI_DEV_NAME

config DISK_FLASH_START
	default 0x0

config DISK_FLASH_MAX_RW_SIZE
	default 256

config DISK_ERASE_BLOCK_SIZE
	default 0x10000

config DISK_FLASH_ERASE_ALIGNMENT
	default 0x10000

config DISK_VOLUME_SIZE
	default 0x4000000

endif # DISK_ACCESS_FLASH

endif # SOC_FLASH_NIOS2_QSPI

endif # FLASH

endif # BOARD_ARROW_MAX1000
```

## boards/nios2/arrow_max1000/arrow_max1000_defconfig
```kconfig
# SPDX-License-Identifier: Apache-2.0

CONFIG_NIOS2=y
CONFIG_SOC_NIOS2E_ZEPHYR=y
CONFIG_BOARD_ARROW_MAX1000=y
CONFIG_HAS_ALTERA_HAL=y
CONFIG_CONSOLE=y
CONFIG_PRINTK=y
CONFIG_SERIAL=y
CONFIG_UART_ALTERA_JTAG=y
CONFIG_UART_CONSOLE=y
```

## soc/nios2/nios2e-zephyr/Kconfig.defconfig
```kconfig
# SPDX-License-Identifier: Apache-2.0

if SOC_NIOS2E_ZEPHYR

config SOC
	string
	default "nios2e-zephyr"

config SYS_CLOCK_HW_CYCLES_PER_SEC
	int
	default 50000000

config ALTERA_AVALON_SYSID
	def_bool y

if GPIO_ALTERA_NIOS2

config ALTERA_AVALON_PIO
	def_bool y

endif # GPIO_ALTERA_NIOS2

if SOC_FLASH_NIOS2_QSPI

config ALTERA_AVALON_QSPI
	def_bool y

endif #SOC_FLASH_NIOS2_QSPI

if I2C_NIOS2

config ALTERA_AVALON_I2C
	def_bool y

endif # I2C_NIOS2

if DMA_NIOS2_MSGDMA

config ALTERA_AVALON_MSGDMA
	def_bool y

endif # DMA_NIOS2_MSGDMA

endif # SOC_NIOS2E_ZEPHYR
```

## soc/nios2/nios2e-zephyr/Kconfig.soc
```kconfig
# SPDX-License-Identifier: Apache-2.0

config SOC_NIOS2E_ZEPHYR
	bool "Nios IIe - Zephyr Golden Configuration"
```
